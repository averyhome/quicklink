## Kconfig
```kconfig
# QuickLink Component Configuration

menu "QuickLink"

    config QUICKLINK_ENABLE_WIFI
        bool "Enable WiFi provisioning support"
        default y
        help
            Enable WiFi provisioning and link WiFi libraries. Disable to build
            BLE-only firmware without pulling esp_wifi/esp_event (e.g. when the
            target has no WiFi or you only need BLE services).

    config QUICKLINK_STRIP_DEBUG
        bool "Strip debug symbols"
        default y
        help
            Strip debug symbols to reduce size and protect code.

    config QUICKLINK_WIFI_MAX_RETRY
        int "WiFi max retry"
        default 5
        range 1 20
        help
            Max WiFi connection retry attempts.

endmenu
```

## sdkconfig.defaults.demo
```kconfig
# ESP32-C3 target
CONFIG_IDF_TARGET="esp32c3"

#
# QuickLink
#
CONFIG_QUICKLINK_ENABLE_WIFI=y
CONFIG_QUICKLINK_STRIP_DEBUG=y
CONFIG_QUICKLINK_WIFI_MAX_RETRY=5
# end of QuickLink
# end of Component config

# mbedTLS configuration 支持完整的 TLS/SSL 功能（用于 WiFi 或 HTTPS）
CONFIG_MBEDTLS_INTERNAL_MEM_ALLOC=y
CONFIG_MBEDTLS_ASYMMETRIC_CONTENT_LEN=y
CONFIG_MBEDTLS_SSL_IN_CONTENT_LEN=16384
CONFIG_MBEDTLS_SSL_OUT_CONTENT_LEN=4096
CONFIG_MBEDTLS_PKCS7_C=y

# Enable HKDF for encryption WiFi 密码加密
CONFIG_MBEDTLS_HKDF_C=y
CONFIG_MBEDTLS_ECDH_C=y

# BLE and NimBLE configuration
CONFIG_BT_ENABLED=y
CONFIG_BT_NIMBLE_ENABLED=y
CONFIG_BT_CONTROLLER_ONLY=n
CONFIG_BT_NIMBLE_ROLE_CENTRAL=n
CONFIG_BT_NIMBLE_ROLE_PERIPHERAL=y
CONFIG_BT_NIMBLE_NVS_PERSIST=n
CONFIG_BT_NIMBLE_CRYPTO_STACK_MBEDTLS=y
CONFIG_BT_NIMBLE_SM_LEGACY=y
CONFIG_BT_NIMBLE_SM_SC=y

# Disable WiFi power management to avoid sleep issues
CONFIG_ESP_WIFI_STA_DISCONNECTED_PM_ENABLE=n
```
